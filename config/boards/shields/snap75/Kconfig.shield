## config/boards/shields/snap75/Kconfig.shield
```kconfig
config SHIELD_SNAP75_LEFT
    def_bool $(shields_list_contains,snap75_left)

config SHIELD_SNAP75_RIGHT
    def_bool $(shields_list_contains,snap75_right)
```
